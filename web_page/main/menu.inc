<!--- navigation menu --->

<div class="menus">

<ul>

<li><a href="http://edge.sourceforge.net/index.html">Home</a>
<li><a href="about.htm">About</a>
<li><a href="http://edge.sourceforge.net/phpBB2/">Forums</a>
<li><a href="screenshots.htm">Screenshots</a>

<li><a href="http://sourceforge.net/projects/edge/files">Downloads</a>

<li> <em>Documentation</em>
  <ul>
    <li><a href="README.txt">User Guide</a>
    <li><a href="edit_guide/overview.htm">Editing Guide</a>
    <li><a href="logs/134.htm">Changelogs</a>
  </ul>
</li>

<li><a href="http://sourceforge.net/projects/edge">SF Summary</a>

<li><a href="credits.htm">Credits</a>
<li><a href="contact.htm">Contact</a>

</ul>
</div>

