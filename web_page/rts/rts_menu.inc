<!--- RTS menu --->

<div class="menus">

<ul>

<li><a href="http://edge.sourceforge.net/index.htm">EDGE Home</a>
<li>&nbsp;

<li> <em>General</em>
<ul>
    <li> <a href="start.htm">What is RTS</a>
    <li> <a href="format.htm">Script Format</a>
    <li> <span class="notdone" hhref="tutorial.htm">Tutorial</span>
</ul>

<!--- [li] &nbsp; --->


<li> <A HREF="directives.htm"> Directives </A>
<if RTSreference="directives">
  <UL>
    <li><a href="clear_all.htm">#CLEAR_ALL</a>
    <li><a href="version.htm">#VERSION</a>
    <li><a href="define.htm">#DEFINE</a>
  </UL>
</if>

<li> <a href="triggers.htm"> Maps &amp; Triggers </a>
<if RTSreference="triggers">
  <UL>
    <li><A HREF="start_map.htm">START_MAP</A>
    <li><A HREF="extend_map.htm">EXTEND_MAP</A>
    <li><A HREF="end_map.htm">END_MAP</A>
    <li><A HREF="radius_trigger.htm">RADIUS_TRIGGER</A>
    <li><A HREF="rect_trigger.htm">RECT_TRIGGER</A>
    <li><A HREF="end_radius_trigger.htm">END_RADIUS_TRIGGER</A>
  </UL>
</if>

<li> <a href="properties.htm"> Properties </a>
<if RTSreference="properties">
  <UL>
    <li><A HREF="tag.htm">TAG</A>
    <li><A HREF="name.htm">NAME</A>
    <li><A HREF="tagged_disabled.htm">TAGGED_DISABLED</A>
    <li><A HREF="tagged_immediate.htm">TAGGED_IMMEDIATE</A>
    <li><A HREF="tagged_independent.htm">TAGGED_INDEPENDENT</A>
    <li><A HREF="tagged_repeatable.htm">TAGGED_REPEATABLE</A>
    <li><A HREF="when_appear.htm">WHEN_APPEAR</A>
    <li><A HREF="when_player_num.htm">WHEN_PLAYER_NUM</A>
    <li><A HREF="tagged_path.htm">TAGGED_PATH</A>
    <li><A HREF="path_event.htm">PATH_EVENT</A>
  </UL>
</if>

<li> <a href="conditions.htm"> Conditions </a>
<if RTSreference="conditions">
  <UL>
    <li><a href="on_death.htm">ON_DEATH</a>
    <li><a href="on_height.htm">ON_HEIGHT</a>
    <li><a href="on_condition.htm">ON_CONDITION</a>
    <li><a href="tagged_use.htm">TAGGED_USE</a>
  </UL>
</if>

<li> <a href="flow_cmd.htm"> Flow control </a>
<if RTSreference="flow">
  <UL>
    <li><a href="jump.htm">JUMP</a>
    <li><a href="label.htm">LABEL</a>
    <li><a href="disable_script.htm">DISABLE_SCRIPT</a>
    <li><a href="enable_script.htm">ENABLE_SCRIPT</a>
    <li><a href="sleep.htm">SLEEP</a>
    <li><a href="wait.htm">WAIT</a>
    <li><a href="retrigger.htm">RETRIGGER</a>
  </UL>
</if>

<li> <a href="level_cmd.htm"> Level commands </a>
<if RTSreference="level">
  <UL>
    <li><a href="activate_linetype.htm">ACTIVATE_LINETYPE</a>
    <li><a href="change_music.htm">CHANGE_MUSIC</a>
    <li><a href="change_tex.htm">CHANGE_TEX</a>
    <li><a href="light_sector.htm">LIGHT_SECTOR</a>
    <li><a href="move_sector.htm">MOVE_SECTOR</a>
    <li><a href="unblock_lines.htm">UNBLOCK_LINES</a>
    <li><a href="block_lines.htm">BLOCK_LINES</a>
    <li><a href="play_sound.htm">PLAY_SOUND</a>
    <li><a href="skill.htm">SKILL</a>
    <li><a href="goto_map.htm">GOTO_MAP</a>
    <li><a href="exit_level.htm">EXIT_LEVEL</a>
  </UL>
</if>

<li> <a href="tip_cmd.htm"> Tips &amp; Menus </a>
<if RTSreference="tips">
  <UL>
    <li><a href="tip.htm">TIP</a>
    <li><a href="tip_slot.htm">TIP_SLOT</a>
    <li><a href="tip_graphic.htm">TIP_GRAPHIC</a>
    <li><a href="tip_set_align.htm">TIP_SET_ALIGN</a>
    <li><a href="tip_set_colour.htm">TIP_SET_COLOUR</a>
    <li><a href="tip_set_pos.htm">TIP_SET_POS</a>
    <li><a href="tip_set_trans.htm">TIP_SET_TRANS</a>
    <li><a href="show_menu.htm">SHOW_MENU</a>
    <li><a href="jump_on.htm">JUMP_ON</a>
  </UL>
</if>

<li> <a href="thing_cmd.htm"> Thing commands </a>
<if RTSreference="thing">
  <UL>
    <li><a href="damage_monsters.htm">DAMAGE_MONSTERS</a>
    <li><a href="damage_player.htm">DAMAGE_PLAYER</a>
    <li><a href="heal_player.htm">HEAL_PLAYER</a>
    <li><a href="give_armour.htm">GIVE_ARMOUR</a>
    <li><a href="give_benefit.htm">GIVE_BENEFIT</a>
    <li><a href="lose_benefit.htm">LOSE_BENEFIT</a>
    <li><a href="spawn_thing.htm">SPAWN_THING</a>
    <li><a href="thing_event.htm">THING_EVENT</a>
  </UL>
</if>

</ul>
</div>

