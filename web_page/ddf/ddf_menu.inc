
<div class="menus">
<ul>

<li><a href="http://edge.sourceforge.net/index.htm">EDGE Home</a>
<li>&nbsp;
<li> <em>General</em>
  <ul>
    <li> <a href="index.htm">What is DDF</a>
    <li> <a href="format.htm">Format of DDF</a>
    <li> <a href="errors.htm">Error messages</a>
    <li> <a href="hints.htm">Hints and Tips</a>
  </ul>

<li><em>Tutorials</em>
  <ul>
    <li> <span class="notdone" hhref="new_monster.htm">New monster</span>
    <li> <span class="notdone" hhref="new_weapon.htm">New weapon</span>
  </ul>

<li> <em>Reference</em>
  <ul>
    <li> <a href="anims.htm"> anims.ddf</a>
    <li> <a href="attacks.htm"> attacks.ddf</a>
    <li> <a href="colmap.htm"> colmap.ddf</a>
    <li> <a href="fonts.htm"> fonts.ddf</a>
    <li> <a href="games.htm"> games.ddf</a>
    <li> <a href="images.htm"> images.ddf</a>
    <li> <a href="language.htm"> language.ddf</a>
    <li> <a href="levels.htm"> levels.ddf</a>
    <li> <a href="line_sec.htm"> lines/sectors.ddf</a>
    <li> <a href="playlist.htm"> playlist.ddf</a>
    <li> <a href="sfx.htm"> sounds.ddf</a>
    <li> <a href="switch.htm"> switch.ddf</a>
    <li> <a href="things.htm"> things.ddf</a>
    <li> <a href="weapons.htm"> weapons.ddf</a>
  </ul>

</ul>
</div>

