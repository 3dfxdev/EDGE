<!--- Changelog menu --->

<div class="menus">

<ul>

<li><a href="http://edge.sourceforge.net/index.htm">EDGE Home</a>
<li>&nbsp;

<li> <em>Changelogs</em>
<ul>
    <li> <a href="119.htm">EDGE 1.19</a>
    <li> <a href="120.htm">EDGE 1.20</a>
    <li> <a href="121.htm">EDGE 1.21</a>
    <li> <a href="122.htm">EDGE 1.22</a>
    <li> <a href="123.htm">EDGE 1.23</a>
    <li> <a href="124.htm">EDGE 1.24</a>
    <li> <a href="125.htm">EDGE 1.25-WIP</a>
    <li> <a href="126.htm">EDGE 1.26</a>
    <li> <a href="127.htm">EDGE 1.27</a>
    <li> <a href="128.htm">EDGE 1.28A</a>
    <li> <a href="129.htm">EDGE 1.29</a>
</ul>

</ul>
</div>

